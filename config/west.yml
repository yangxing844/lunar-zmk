## config/west.yml
```yaml
manifest:
  remotes:
    - name: zmk
      url-base: https://github.com/zmkfirmware
    - name: badjeff
      url-base: https://github.com/badjeff
    - name: sekigon
      url-base: https://github.com/sekigon-gonnoc
  projects:
    - name: zmk
      remote: zmk
      revision: main
      import: app/west.yml
    - name: zmk-pmw3610-driver
      remote: badjeff
      revision: main
    - name: zmk-driver-paw3222
      remote: sekigon
      revision: main
  self:
    path: config
```
